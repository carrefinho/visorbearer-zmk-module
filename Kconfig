## Kconfig
```kconfig
rsource "drivers/Kconfig"

config VISORBEARER_LED
    bool "Enable LED bar status indicators for Visorbearer keyboard"
    select LED
    select ZMK_LP5012

if VISORBEARER_LED

# Animation parameters (optimized for 100Hz refresh rate)
config VISORBEARER_LED_FADE_STEP_SIZE
    int "Brightness change per animation frame (0-100)"
    default 8
    range 1 50
    help
      Controls how fast LEDs fade between brightness levels.
      Higher values = faster transitions, lower values = smoother fades.

config VISORBEARER_LED_INIT_FADE_STEP_SIZE
    int "Brightness change per init fade frame (0-100)"
    default 15
    range 1 50
    help
      Controls how fast LEDs fade during the initialization sequence.

config VISORBEARER_LED_BREATH_STEP_SIZE
    int "Brightness change per breath frame (0-100)"
    default 3
    range 1 20
    help
      Controls the speed of the breathing animation.
      Higher values = faster breathing, lower values = slower breathing.

config VISORBEARER_LED_SHOW_MODIFIERS
    bool "Show modifier keys on connection bar"
    default y
    help
      When enabled, the connection bar displays active modifier keys (Shift, Ctrl, Alt, GUI)
      when they are pressed. When disabled, the connection bar only shows BT connection status.

if VISORBEARER_LED_SHOW_MODIFIERS

config VISORBEARER_LED_MODIFIER_FADE_STEP_SIZE
    int "Brightness change per modifier animation frame (0-100)"
    default 25
    range 1 50
    help
      Controls how fast modifier key LEDs fade in/out when pressed/released.

config VISORBEARER_LED_MODIFIER_ORDER
    string "Order of modifiers on the connection bar"
    default "SCAG"
    help
      Controls which modifier is shown on each of the four segments of the connection
      bar, from left to right. Use the characters S (shift), C (control), A (alt),
      and G (GUI) exactly once. Invalid values fall back to the default of "SCAG".

endif # VISORBEARER_LED_SHOW_MODIFIERS

config VISORBEARER_LED_BREATH_MIN
    int "Minimum brightness for breathing effect (0-100)"
    default 5
    range 0 50
    help
      The lowest brightness level during breathing animation.

config VISORBEARER_LED_BREATH_MAX
    int "Maximum brightness for breathing effect (0-100)"
    default 100
    range 50 100
    help
      The highest brightness level during breathing animation.

# Timing parameters
config VISORBEARER_LED_STARTUP_DISPLAY_TIME_MS
    int "Show status duration at startup in milliseconds"
    default 6000
    help
      How long to show LED status indicators at startup.

config VISORBEARER_LED_EVENT_DISPLAY_TIME_MS
    int "Show status duration for events in milliseconds"
    default 3000
    help
      How long to show LED status indicators when events occur
      (profile changes, connection changes, etc).

config VISORBEARER_LED_INIT_PAUSE_TIME_MS
    int "Pause before showing status after init in milliseconds"
    default 300
    help
      Brief pause between initialization sequence and status display.

# Battery level thresholds
config VISORBEARER_LED_BATTERY_CRITICAL_THRESHOLD
    int "Critical battery level percentage"
    default 8
    range 1 20
    help
      Below this percentage, battery indicator shows red and breathes.

config VISORBEARER_LED_BATTERY_LOW_THRESHOLD
    int "Low battery level percentage"
    default 15
    range 10 30
    help
      Between CRITICAL and LOW thresholds, first segment shows yellow.


config VISORBEARER_LED_BATTERY_GRANULAR
    bool "Enable granular battery percentage display"
    default y
    help
      Show battery percentage with 3 brightness levels within each 25% segment.
      For the last lit segment: 0-32% = off, 33-66% = 45% brightness, 67-100% = 70% brightness.
      When disabled, uses simple 25% segments at full brightness.

config VISORBEARER_SOFT_OFF
    bool
    default y
    depends on DT_HAS_ZMK_BEHAVIOR_VISORBEARER_SOFT_OFF_ENABLED
    select ZMK_PM_SOFT_OFF

endif # VISORBEARER_LED
```

## boards/shields/visorbearer/Kconfig.defconfig
```kconfig
if SHIELD_VISORBEARER

config ZMK_KEYBOARD_NAME
   default "Visorbearer"

config VISORBEARER_LED
   default y

endif
```

## drivers/led/Kconfig
```kconfig
config ZMK_LP5012
	bool "LP5012 LED controller with HW enable PM"
	default y
	depends on DT_HAS_ZMK_TI_LP5012_ENABLED
	select I2C
	select PM_DEVICE
```

## dts/bindings/behaviors/zmk,behavior-visorbearer-led.yaml
```yaml
description: Visorbearer LED indicator behavior

compatible: "zmk,behavior-visorbearer-led"

include: zero_param.yaml

properties:
  indicate-battery:
    type: boolean
  indicate-connectivity:
    type: boolean
```

## dts/bindings/behaviors/zmk,behavior-visorbearer-soft-off.yaml
```yaml
# Copyright (c) 2024
# SPDX-License-Identifier: MIT

description: Visorbearer soft-off behavior with LED animation

compatible: "zmk,behavior-visorbearer-soft-off"

include: [base.yaml]

properties:
  hold-time-ms:
    type: int
    description: |
      How long the soft-off key must be held before triggering soft-off.
      If set to zero, soft-off will trigger on key release instead of requiring a hold.
    default: 0
```
